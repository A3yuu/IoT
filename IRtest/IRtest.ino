//全灯
int dataOFFAir[] = {
8140, 4087, 577, 1520, 570, 527, 570, 510, 580, 527, 573, 1513,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 0
};
int dataCoolAir[] = {
4453, 2225, 322, 824, 317, 281, 318, 280, 318, 823, 322, 825,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 0
};
int dataHotAir[] = {
4455, 2234, 317, 281, 319, 280, 320, 825, 322, 824, 318, 281,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 0
};
int buf[1024];
const int pinSend = 16;
const int pinRecv = 17;
//赤外送信
void sendData(int datas[], int pin) {
  boolean data = HIGH;
  for (int i = 0; datas[i] != 0; i++) {
    if (data) {
      for (int j = 0; j < datas[i]; j += 26) {
        digitalWrite(pin, HIGH);
        delayMicroseconds(13);
        digitalWrite(pin, LOW);
        delayMicroseconds(13);
      }
    }
    else {
      digitalWrite(pin, LOW);
      delayMicroseconds(datas[i]);
    }
    data = !data;
  }
  digitalWrite(pin, LOW);
}
void setup() {
  Serial.begin(115200);
  pinMode(pinSend, OUTPUT);
  pinMode(pinRecv, INPUT);
  Serial.println("This is IR test");
}
void loop() {
  //再現
  //sendData(dataOFFAir , pinSend);
  //delay(2000);

  //解析
  
    if(digitalRead(pinRecv) == LOW){
    boolean data;
    boolean now = LOW;
    int c=0;
    int p=0;
    for(;c<30000;c++){
      data = digitalRead(pinRecv);
      if(data != now){
        now = data;
        buf[p++]=c;
        c=0;
      }
      delayMicroseconds(10);
    }
    for(int i=0;i<p;i++)Serial.println(buf[i]);
    Serial.println("end");
    }
    delayMicroseconds(10);
  
}
